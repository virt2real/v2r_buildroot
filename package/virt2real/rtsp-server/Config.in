## package/virt2real/speech/Config.in
```kconfig
config BR2_PACKAGE_SPEECH
	bool "virt2real speech scripts"
	help
	    Speech scripts for Virt2real board
```

## package/virt2real/teleguejs/Config.in
```kconfig
config BR2_PACKAGE_TELEGUEJS
	bool virt2real_teleguejs
	select BR2_PACKAGE_NODEJS
	select BR2_PACKAGE_NODEJS_MODULES
	select BR2_PACKAGE_GSTD
	help
	    NodeJS server for Virt2real Telegue
```

## package/virt2real_nodejs_modules/Config.in
```kconfig
config BR2_PACKAGE_VIRT2REAL_NODEJS_MODULES
	bool "virt2real_nodejs_modules"
	help
	    NodeJS libraries for Virt2real board
```
