## package/multimedia/ti-gstreamer-dmai/Config.in
```kconfig
config BR2_PACKAGE_TI_GSTREAMER_DMAI
	bool "ti-gstreamer-dmai"
	select BR2_PACKAGE_GSTREAMER
	select BR2_PACKAGE_GST_PLUGINS_BASE
	help
	  GSTREAMER Plugin (gstreamer-ti) for TI ARM/DSP
	  processors

	  https://gforge.ti.com/gf/project/gstreamer_ti/
```

## package/nanomsg/Config.in
```kconfig
config BR2_PACKAGE_NANOMSG
	bool "nanomsg"
	help
	  nanomsg library is a simple high-performance implementation of several "scalability protocols". 
	  Scalability protocol's job is to define how multiple applications communicate to form a single distributed application.

	  http://nanomsg.org
```

## package/nginx/Config.in
```kconfig
config BR2_PACKAGE_NGINX
	bool "nginx"
	help
	 A high perfomance http and reverse proxy server

	  http://www.nginx.org/

config BR2_PACKAGE_NGINX_AIO
	bool "Enable AIO"
	depends on BR2_PACKAGE_NGINX
	help
	  Enable AIO support.

config BR2_PACKAGE_NGINX_HTTP_CACHE
	bool "Enable Cache Module"
	depends on BR2_PACKAGE_NGINX
	select BR2_PACKAGE_OPENSSL
	help
	  Enable HTTP Cache Module.

config BR2_PACKAGE_NGINX_HTTP_GZIP_STATIC
	bool "Enable GZip Static Module"
	depends on BR2_PACKAGE_NGINX
	select BR2_PACKAGE_ZLIB
	help
	  Enable HTTP GZip Static Module.

config BR2_PACKAGE_NGINX_HTTP_REWRITE
	bool "Enable Rewrite Module"
	depends on BR2_PACKAGE_NGINX
	select BR2_PACKAGE_PCRE
	help
	  Enable HTTP Rewrite Module.

config BR2_PACKAGE_NGINX_HTTP_SSL
	bool "Enable SSL Module"
	depends on BR2_PACKAGE_NGINX
	select BR2_PACKAGE_OPENSSL
	help
	  Enable HTTP SSL Module.

config BR2_PACKAGE_NGINX_HTTP_RTMP
	bool "Enable RTMP module"
	depends on BR2_PACKAGE_NGINX
	help
	  Enable NGINX-based Media Streaming Server.
```

## package/pjsip/Config.in
```kconfig
config BR2_PACKAGE_PJSIP
	bool "pjsip"
	depends on BR2_PACKAGE_UTIL_LINUX_LIBUUID
	help
	 PJSIP is a free and open source multimedia communication library written in C language 
	 implementing standard based protocols such as SIP, SDP, RTP, STUN, TURN, and ICE.

	 http://www.pjsip.org/
```

## package/powertop/Config.in
```kconfig
config BR2_PACKAGE_POWERTOP
	bool "powertop"
	help
	https://github.com/vickylinuxer/powertop
```

## package/rfkill/Config.in
```kconfig
config BR2_PACKAGE_RFKILL
	bool "rfkill"
	help
	  rfkill

	  https://www.kernel.org/pub/software/network/rfkill/
```

## package/ti-codec-engine/Config.in
```kconfig
config BR2_PACKAGE_TI_CODEC_ENGINE
	bool "ti-linuxutils"
	select BR2_PACKAGE_TI_FRAMEWORK_COMPONENTS
	select BR2_PACKAGE_TI_XDAIS
	select BR2_PACKAGE_TI_XDCTOOLS
	select BR2_PACKAGE_TI_LINUXUTILS
	help
	  Codec Engine is a framework that automates the invocation and
	  instantiation of XDAIS-compliant algorithms and XDM-compliant
	  codecs.

	  http://software-dl.ti.com/dsps/dsps_public_sw/sdo_sb/targetcontent/ce/
```

## package/ti-dm365-codecs-aaclcenc/Config.in
```kconfig
config BR2_PACKAGE_TI_DM365_CODECS_AACLCENC
	bool "ti-dm365-codecs-aaclc4enc"
	help
	  MPEG-2/4 AAC-LC audio encoder

	  http://software-dl.ti.com/dsps/dsps_public_sw/codecs/DM365/index_FDS.html
```

## package/ti-dm365-codecs-h264enc/Config.in
```kconfig
config BR2_PACKAGE_TI_DM365_CODECS_H264ENC
	bool "ti-dm365-codecs-h264enc"
	help
	  H.264 1080P 30fps encoder for DM3xx processors

	  http://software-dl.ti.com/dsps/dsps_public_sw/codecs/DM365/index_FDS.html
```

## package/ti-dm365-codecs-mpeg4enc/Config.in
```kconfig
config BR2_PACKAGE_TI_DM365_CODECS_MPEG4ENC
	bool "ti-dm365-codecs-mpeg4enc"
	help
	  MPEG4 SP/ASP@L5 Encoder upto 1080P using HDVICP

	  http://software-dl.ti.com/dsps/dsps_public_sw/codecs/DM365/index_FDS.html
```

## package/ti-dm365mmap/Config.in
```kconfig
config BR2_PACKAGE_TI_DM365MMAP
	bool "ti-dm365mmap"
	help
	  User space DMA module for DM365. Part of the DVSDK
```

## package/ti-dmai/Config.in
```kconfig
config BR2_PACKAGE_TI_DMAI
	bool "ti-dmai"
	select BR2_PACKAGE_ALSA_LIB
	select BR2_PACKAGE_TI_FRAMEWORK_COMPONENTS
	select BR2_PACKAGE_TI_CODEC_ENGINE
	select BR2_PACKAGE_TI_XDCTOOLS
	help
	  The DaVinci Multimedia Application Interface (DMAI) is a
	  thin utility layer on top of the operating system (Linux
	  or DSP/BIOS) and the Codec Engine (CE) to assist in quickly
	  writing portable applications on a DaVinci platform.

	  https://gforge.ti.com/gf/project/dmai/
```

## package/ti-framework-components/Config.in
```kconfig
config BR2_PACKAGE_TI_FRAMEWORK_COMPONENTS
	bool "ti-framework-components"
	help
	  The Framework Components product enables faster implementation
	  of application frameworks that use algorithms and codecs that
	  comply to the XDAIS standard. XDAIS defines standards that prevent
	  algorithms from hard-coding ownership of system resources such
	  as memory and DMA channels. An XDAIS-compliant algorithm enables
	  the application framework to query it and provide information on
	  specific memory DMA and other resources it needs. This makes
	  integration of algorithms from multiple sources much easier.

	  http://software-dl.ti.com/dsps/dsps_public_sw/sdo_sb/targetcontent/fc/
```

## package/ti-gstreamer/Config.in
```kconfig
config BR2_PACKAGE_TI_GSTREAMER
	bool "ti-gstreamer"
	select BR2_PACKAGE_TI_DMAI
	select BR2_PACKAGE_GSTREAMER
	select BR2_PACKAGE_GST_PLUGINS_BASE
	help
	  GSTREAMER Plugin (gstreamer-ti) for TI ARM/DSP
	  processors

	  https://gforge.ti.com/gf/project/gstreamer_ti/
```

## package/ti-linuxutils/Config.in
```kconfig
config BR2_PACKAGE_TI_LINUXUTILS
	bool "ti-linuxutils"
	depends on BR2_LINUX_KERNEL
	help
	  The Linux Utils product consists of the following (not
	  all are applicable to a given device):

	  CMEM: A memory manager that can grant physically contiguous 
	        memory for general use (e.g. as image or video data buffers)
	  SDMA: A programming module that provides Linux applications with
	        access to SDMA functionality
	  EDMA: A programming module that provides Linux applications with
	        access to EDMA functionality
	  VICP: A utility library that provides the ability for user-mode
	        Linux applications to request VICP channels and operate on
	        a channel using direct, memory-mapped access to the channel's
	        registers.

	  http://software-dl.ti.com/dsps/dsps_public_sw/sdo_sb/targetcontent/linuxutils/
```

## package/ti-xdais/Config.in
```kconfig
config BR2_PACKAGE_TI_XDAIS
	bool "ti-xdais"
	help
	  The XDAIS (eXpress DSP Algorithm Interoperability Standard)
	  Developer's Kit provides the header files and specifications
	  needed to implement XDAIS-compliant algorithms.

	  http://software-dl.ti.com/dsps/dsps_public_sw/sdo_sb/targetcontent/xdais/
```

## package/ti-xdctools/Config.in
```kconfig
config BR2_PACKAGE_TI_XDCTOOLS
	bool "ti-xdctools"
	help
	  TI XDCtools (RTSC - Real Time Software Components - http://rtsc.eclipse.org)

	  http://software-dl.ti.com/dsps/dsps_public_sw/sdo_sb/targetcontent/rtsc/
```

## package/tinc/Config.in
```kconfig
config BR2_PACKAGE_TINC
	bool "tinc"
	help
	 tinc is a Virtual Private Network (VPN) daemon that uses tunnelling and 
	 encryption to create a secure private network between hosts on the Internet.
```

## package/uaputl/Config.in
```kconfig
config BR2_PACKAGE_UAPUTL
	bool "uaputl"
	help
	  Marvel uaputl for configuring WLAN chipset in master mode.
```

## package/virt2real/Config.in
```kconfig
menu "Virt2real additional packages"
source "package/virt2real/speech/Config.in"
source "package/virt2real/nodejs_modules/Config.in"
source "package/virt2real/teleguejs/Config.in"
source "package/virt2real/gpio-event/Config.in"
source "package/virt2real/rtsp-server/Config.in"
source "package/virt2real/rcboard/Config.in"
source "package/virt2real/i2c_write/Config.in"
endmenu
```

## package/virt2real/gpio-event/Config.in
```kconfig
config BR2_PACKAGE_GPIO_EVENT
	bool "gpio-event"
	help
	  gpio-event driver controls
```

## package/virt2real/i2c_write/Config.in
```kconfig
config BR2_PACKAGE_I2C_WRITE
	bool "I2C write"
	help
	  I2C writer for many registers from text file
```

## package/virt2real/nodejs_modules/Config.in
```kconfig
config BR2_PACKAGE_NODEJS_MODULES
	bool "virt2real_nodejs_modules"
	help
	    NodeJS libraries for Virt2real board
```
