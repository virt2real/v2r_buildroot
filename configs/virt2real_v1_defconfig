## package/DM36x/ipiped/Config.in
```kconfig
config BR2_PACKAGE_IPIPED
	bool "ipiped"
	help
	 Image Pipe Daemon is a daemon with DBus interface that allows to control and
	 interact with the functionality provided by the image pipe (ipipe) hardware
	 on Texas Instruments SoC families like Davincis or OMAP.

	 https://github.com/RidgeRun/ipiped
```

## package/babeld/Config.in
```kconfig
config BR2_PACKAGE_BABELD
	bool "Babel daemon"
	help
	    Babel is a loop-avoiding distance-vector routing protocol roughly
	    based on HSDV and AODV, but with provisions for link cost estimation
	    and redistribution of routes from other routing protocols.

	    https://github.com/jech/babeld
```

## package/dejavu-fonts/Config.in
```kconfig
config BR2_PACKAGE_DEJAVU_FONTS
	bool "dejavu fonts"
	help
	The DejaVu fonts are a font family
	    based on the Vera Fonts
 
		http://dejavu-fonts.org/wiki/Main_Page
```

## package/gphoto2/Config.in
```kconfig
config BR2_PACKAGE_GPHOTO2
	bool "gphoto2"
	default n
	select BR2_PACKAGE_LIBGPHOTO2
	select BR2_PACKAGE_LIBEXIF
	select BR2_PACKAGE_POPT
	help
	  GPhoto2
```

## package/gphotofs/Config.in
```kconfig
config BR2_PACKAGE_GPHOTOFS
	bool "gphotofs"
	default n
	select BR2_PACKAGE_LIBGPHOTO2
	help
	  FUSE based filesystem for gphoto2.
```

## package/libgphoto2/Config.in
```kconfig
config BR2_PACKAGE_LIBGPHOTO2
	bool "libgphoto2"
	default n
	select BR2_PACKAGE_LIBUSB
	help
	  libgphoto2 is a library that can be used by applications to access various 
	  digital cameras.  
```

## package/linuxconsoletools/Config.in
```kconfig
config BR2_PACKAGE_LINUXCONSOLETOOLS
	bool "linuxconsoletools"
	help
	    This package contains the following utilities and associated
	    documentation:
	    * inputattach - connects legacy serial devices to the input layer
	    * joystick utilities - calibrate and test joysticks and joypads

	     http://sourceforge.net/projects/linuxconsole/files/
```

## package/ltwheelconf/Config.in
```kconfig
config BR2_PACKAGE_LTWHEELCONF
        bool "ltwheelconf"
        help
          This tool allows you to change various settings of the Logitech racing wheels
          -> Driving Force
          -> Momo Racing
          -> Momo Force
          -> Driving Force Pro
          -> Driving Force GT
          -> G25
          -> G27

          https://github.com/TripleSpeeder/LTWheelConf
```

## package/miniupnp/Config.in
```kconfig
config BR2_PACKAGE_MINIUPNP
	bool "miniupnp utils"
	help
	  miniupnpc
	  Small UPnP client

	  miniupnpd is an IGD and NAT-PMP daemon
	  miniupnpd requires minissdpd in the runtime, but not to compile

	  minissdpd is an SSDP proxy to allow multiple UPnP programs to share port 1900.
	  miniupnpd requires it in the runtime.

	  http://miniupnp.free.fr/files/
```

## package/miniupnpc/Config.in
```kconfig
config BR2_PACKAGE_MINIUPNPC
	bool "miniupnpc"
	help
	  Small UPnP client

	  http://miniupnp.free.fr/files/
```

## package/miredo/Config.in
```kconfig
config BR2_PACKAGE_MIREDO
	bool "miredo"
	depends on BR2_INET_IPV6
	help
	 Miredo is an open-source Teredo IPv6 tunneling software, for Linux and the BSD operating systems.

comment "miredo needs a IPv6 support"
        depends on !(BR2_INET_IPV6)
```

## package/mono/Config.in
```kconfig
config BR2_PACKAGE_MONO
	bool "mono"
	select BR2_PACKAGE_LIBGLIB2
	select BR2_PACKAGE_PKG_CONFIG
	select BR2_PACKAGE_LIBICONV if !BR2_ENABLE_LOCALE
	help
	  Mono is a free and open source project to create an Ecma 
          standard-compliant, .NET Framework-compatible set of tools 
          including, among others, a C# compiler and a Common Language 
          Runtime.
```

## package/multimedia/Config.in
```kconfig
menu "Audio and video applications"
source "package/multimedia/alsa-utils/Config.in"
source "package/multimedia/aumix/Config.in"
source "package/multimedia/bellagio/Config.in"
source "package/multimedia/espeak/Config.in"
source "package/multimedia/faad2/Config.in"
source "package/multimedia/festival/Config.in"
source "package/multimedia/flac/Config.in"
source "package/multimedia/ffmpeg/Config.in"
source "package/multimedia/gstreamer/Config.in"
source "package/multimedia/gst-ffmpeg/Config.in"
source "package/multimedia/gst-dsp/Config.in"
source "package/multimedia/gst-fsl-plugins/Config.in"
source "package/multimedia/gst-omapfb/Config.in"
source "package/multimedia/gst-plugins-base/Config.in"
source "package/multimedia/gst-plugins-good/Config.in"
source "package/multimedia/gst-plugins-bad/Config.in"
source "package/multimedia/gst-plugins-ugly/Config.in"
source "package/multimedia/gst-rtsp-server/Config.in"
source "package/multimedia/ti-gstreamer-dmai/Config.in"
source "package/multimedia/lame/Config.in"
source "package/multimedia/madplay/Config.in"
source "package/multimedia/mpd/Config.in"
source "package/multimedia/mpg123/Config.in"
source "package/multimedia/mplayer/Config.in"
source "package/multimedia/musepack/Config.in"
source "package/opus-tools/Config.in"
source "package/multimedia/pulseaudio/Config.in"
source "package/multimedia/rtmpdump/Config.in"
source "package/multimedia/tidsp-binaries/Config.in"
source "package/multimedia/v4l2grab/Config.in"
source "package/multimedia/vorbis-tools/Config.in"
source "package/multimedia/wavpack/Config.in"
source "package/multimedia/sox/Config.in"
source "package/multimedia/sphinxbase/Config.in"
source "package/multimedia/pocketsphinx/Config.in"
source "package/multimedia/gstd/Config.in"
#source "package/multimedia/ipiped/Config.in"
#source "package/multimedia/gst-usb/Config.in"
source "package/yavta/Config.in"
endmenu
```

## package/multimedia/gst-rtsp-server/Config.in
```kconfig
config BR2_PACKAGE_GST_RTSP_SERVER
	bool "gst-rtsp-server"
	select BR2_PACKAGE_GSTREAMER
	help
	 Standalone RTSP server.
	 
	 http://gstreamer.freedesktop.org/src/gst-rtsp-server/
```

## package/multimedia/gst-ti-dmai/Config.in
```kconfig
config BR2_PACKAGE_GST_TI_DMAI
	bool "gst-ti-dmai"
	select BR2_PACKAGE_GSTREAMER
	select BR2_PACKAGE_GST_PLUGINS_BASE
	help
	  GSTREAMER Plugin for TI ARM/DSP processors

	  https://gforge.ti.com/gf/project/gstreamer_ti/
```

## package/multimedia/gst-usb/Config.in
```kconfig
config BR2_PACKAGE_GST_USB
	bool "gst-usb"
	select BR2_PACKAGE_GSTREAMER
	help
	 gst-usb-plugin provides an usbsink and usbsrc for gstreamer to allow
	 embedded systems to create gstreamer pipelines between devices connected
	 by usb connections.

	 https://github.com/RidgeRun/gst-plugin-usb
```

## package/multimedia/gst1-ce-plugin/Config.in
```kconfig
config BR2_PACKAGE_GST1_CE_PLUGIN
	bool "gst1-ce-plugin"
	depends on BR2_PACKAGE_GSTREAMER1
	select BR2_PACKAGE_GST1_PLUGINS_BASE
	select BR2_PACKAGE_LIBDM36X_CODECS
	help
	  This is a GStreamer plugin for Texas Instruments SoC platforms using the CodecEngine API.
	  This plugin is a follow up project developed by RidgeRun to the gst-dmai-plugin available
	  from http://gstreamer.ti.com, that adds support for the GStreamer 1.0 API and merges the
	  design concepts from the ddompe branch into a refactored design.
	  
	  Currently this projects targets support for the following platforms:
	  - DM36x
```

## package/multimedia/gstd/Config.in
```kconfig
config BR2_PACKAGE_GSTD
	bool "gstd"
	select BR2_PACKAGE_DBUS
	select BR2_PACKAGE_GSTREAMER
	select BR2_PACKAGE_GST_PLUGINS_BASE
	help
	  GStreamer Daemon, also called gstd, is a GStreamer framework fore controlling
	  audio and video streaming using D-Bus messages. Qt applications, web interfaces,
	  and GStreamer element test suites show different ways the framework can be
	  utilized.  GStreamer Daemon is gst-launch on steroids where you can create
	  a GStreamer pipeline, play, pause, change speed, skip around, and even change
	  element parameter settings all while the pipeline is active.

	  https://github.com/RidgeRun/gstd
```

## package/multimedia/libdm36x-codecs/Config.in
```kconfig
config BR2_PACKAGE_LIBDM36X_CODECS
	bool "libdm36x-codecs"
	help
	  Library for TI's DM365 SoC Codecs by RidgeRun
	  
	  This library builds a autotools (and Linux in general) friendly version of the
	  codecs for the dm36x SoC family. This greatly simplifies the process of building
	  apps that require from APIs related to CodecEngine.
```

## package/multimedia/pocketsphinx/Config.in
```kconfig
config BR2_PACKAGE_POCKETSPHINX
	bool "pocketsphinx"
	default y
	help
	  pocketsphinx is apps.
```

## package/multimedia/rtmpdump/Config.in
```kconfig
config BR2_PACKAGE_RTMPDUMP
	bool "rtmpdump"
	select BR2_PACKAGE_ZLIB
	select BR2_PACKAGE_OPENSSL
	help
	 The toolkit for RTMP streams.
	 http://rtmpdump.mplayerhq.hu/
```

## package/multimedia/sox/Config.in
```kconfig
config BR2_PACKAGE_SOX
	bool "sox"
	select BR2_PACKAGE_LIBMAD
	select BR2_PACKAGE_LIBID3TAG
	select BR2_PACKAGE_LIBVORBIS
	select BR2_PACKAGE_FLAC
	help
	 SoX is a command line utility that can convert various formats
	 of computer audio files in to other formats. It can also apply
	 various effects to these sound files during the conversion.
	 As an added bonus, SoX can play and record audio files on
	 several unix-style platforms.

	 http://sox.sourceforge.net/
```

## package/multimedia/sphinx/Config.in
```kconfig
config BR2_PACKAGE_SPHINXBASE
	bool "sphinxbase"
	help
	  voice recognition library thing.
	  
if BR2_PACKAGE_SPHINXBASE
	config BR2_PACKAGE_POCKETSPHINX
	bool "pocketsphinx"
	default y
	help
	  pocketsphinx is apps.
endif
```

## package/multimedia/sphinxbase/Config.in
```kconfig
config BR2_PACKAGE_SPHINXBASE
	bool "sphinxbase"
	default y
	help
	  voice recognition library thing.
```
